/*************************************************************************************
  Assignment 2 OLED by Sidra Morchower [903835808] and Philipp Hemkemeyer [903840326]
**************************************************************************************/

#include <SPI.h>
#include <Wire.h>
#include <Adafruit_GFX.h>
#include <Adafruit_SSD1306.h>

#define SCREEN_WIDTH 128  // OLED display width, in pixels
#define SCREEN_HEIGHT 64  // OLED display height, in pixels

// Declaration for an SSD1306 display connected to I2C (SDA, SCL pins)
// The pins for I2C are defined by the Wire-library.
// On an arduino UNO:       A4(SDA), A5(SCL)
// On an arduino MEGA 2560: 20(SDA), 21(SCL)
// On an arduino LEONARDO:   2(SDA),  3(SCL), ...
#define OLED_RESET 4         // Reset pin # (or -1 if sharing Arduino reset pin)
#define SCREEN_ADDRESS 0x3D  ///< See datasheet for Address; 0x3D for 128x64, 0x3C for 128x32
Adafruit_SSD1306 display(SCREEN_WIDTH, SCREEN_HEIGHT, &Wire, OLED_RESET);


// Setup for buttons
#define BUTTON_PIN_DOWN 3
#define BUTTON_PIN_RED 2
int downButtonState = 0;
int selectButtonState = 0;

// Current menu selection [0-2]
int menuSelection = 0;

// Setup for LED
#define LED_PIN 9

// Setup for bitmap
#define LOGO_WIDTH 128
#define LOGO_HEIGHT 64
// Georgia Tech logo as bitmap, 128x64px
const unsigned char GT_LOGO[] PROGMEM = {
  0x00, 0x00, 0x00, 0x00, 0x00, 0x00, 0x00, 0x00, 0x00, 0x00, 0x00, 0x00, 0x00, 0x00, 0x00, 0x00,
  0x00, 0x00, 0x00, 0x00, 0x00, 0x00, 0x00, 0x00, 0x00, 0x00, 0x00, 0x00, 0x00, 0x00, 0x00, 0x00,
  0x00, 0x00, 0x00, 0x00, 0x00, 0x00, 0x00, 0x00, 0x00, 0x00, 0x00, 0x00, 0x00, 0x00, 0x00, 0x00,
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  0x00, 0x00, 0x00, 0x00, 0x00, 0x00, 0x00, 0x00, 0x00, 0x00, 0x00, 0x00, 0x00, 0x00, 0x00, 0x00
};


/* Ssetup when Arudino starts */
void setup() {
  Serial.begin(9600);  // Start serial connection to computer for print etc.

  // SSD1306_SWITCHCAPVCC = generate display voltage from 3.3V internally
  if (!display.begin(SSD1306_SWITCHCAPVCC, SCREEN_ADDRESS)) {
    Serial.println(F("SSD1306 allocation failed"));
    for (;;)
      ;  // Don't proceed, loop forever
  }

  // Initialize button pins
  pinMode(BUTTON_PIN_DOWN, INPUT);
  pinMode(BUTTON_PIN_RED, INPUT);

  // Initialize LED pin
  pinMode(LED_PIN, OUTPUT);

  // Show initial display buffer contents on the screen --
  // the library initializes this with an Adafruit splash screen.
  display.display();
  delay(2000);             // Pause for 2 seconds
  display.clearDisplay();  // Clear the buffer

  showHelloText();  // Show startup text
  delay(4000);      // Wait 4 seconds to show text

  showMenu();                                        // Show the menu
  display.fillRect(0, 0, 128, 16, SSD1306_INVERSE);  // Highlight first option
  display.display();                                 // Show the highlight box
}


/* Program that runs continuously */
void loop() {

  // Check for both buttons if pressed or not
  downButtonState = digitalRead(BUTTON_PIN_DOWN);
  selectButtonState = digitalRead(BUTTON_PIN_RED);

  // Check if down-button is pressed to change menu selection
  if (downButtonState == 1) {
    menuSelection += 1;  // Next menu item is shown until the end is reach (2)

    if (menuSelection == 3) {
      menuSelection = 0;  // if last position (2) is reached go back to first
    }

    display.clearDisplay();  // Clear old display selection
    showMenu();              // Draw new menu (without selection)
    // Highlight correct option depending on selected menu option
    switch (menuSelection) {
      case 0:                                              // Highlight first option
        display.fillRect(0, 0, 128, 16, SSD1306_INVERSE);  // Invert colors of upper field
        break;
      case 1:                                               // Highlight second option
        display.fillRect(0, 16, 128, 17, SSD1306_INVERSE);  // Invert colors of middle field
        break;
      case 2:                                               // Highlight third option
        display.fillRect(0, 33, 128, 17, SSD1306_INVERSE);  // Invert colors of lower field
        break;
    }
    display.display();  // Show the menu with new selection
  }

  // Show each screen if Select-button is pressed
  if (selectButtonState == 1) {

    // Show correct screen depending on selected menu option
    switch (menuSelection) {
      case 0:               // Show 'Start' screen (bitmap)
        showFirstScreen();  // Shows bitmap
        blinkLED();         // Blinks the additional LED
        break;
      case 1:                // Show 'Stats' screen (text)
        showSecondScreen();  // Shows the text
        break;
      case 2:                    // Show 'End" screen (empty)
        display.clearDisplay();  // Clears the display (empty/black)
        display.display();       // Shows the empty display
        break;
    }
  }

  delay(100);  // Delay to avoid debouncing of button
}


/* Show the startup text 'Hello' */
void showHelloText(void) {
  display.clearDisplay();               // Empty screen to only show text
  display.setTextSize(3);               // Draw 3X-scale text
  display.setTextColor(SSD1306_WHITE);  // Set color to white
  display.setCursor(10, 0);             // Put the cursor a bit more in the screen (x=10)
  display.println("Hello");             // Print Hello
  display.display();                    // Show text on display
}

/* Show the menu (without a selection) */
void showMenu(void) {
  display.clearDisplay();               // Empty screen to only show the menu
  display.setTextSize(2);               // Draw 2X-scale text
  display.setTextColor(SSD1306_WHITE);  // Set color to white
  display.setCursor(10, 0);             // Put the cursor a bit more in the screen (x=10)
  display.println("1. Start");          // Print the first menu option
  display.setCursor(10, 17);            // Put the cursor a bit more in the screen (x=10) and underneath the first option (y=17)
  display.println("2. Stats");          // Print the second menu option
  display.setCursor(10, 34);            // Put the cursor a bit more in the screen (x=10) and underneath the second option (y=34)
  display.println("3. End");            // Print the third menu option
  display.display();                    // Show text on display
}

/* Show the bitmap */
void showFirstScreen(void) {
  display.clearDisplay();  // Empty screen to only show the bitmap

  // Use drawBitmap function of library to show the GT logo
  display.drawBitmap(
    (display.width() - LOGO_WIDTH) / 2,
    (display.height() - LOGO_HEIGHT) / 2,
    GT_LOGO, LOGO_WIDTH, LOGO_HEIGHT, 1);
  display.display();  // Show logo on display
}

/* Blink the LED 3 times */
void blinkLED(void) {

  // Repeat the blink 3 times via for loop
  for (int i = 0; i <= 2; i += 1) {
    digitalWrite(LED_PIN, HIGH);  // On
    delay(500);                   // Pause 500ms
    digitalWrite(LED_PIN, LOW);   // Off
    delay(500);                   // Pause 500ms
  }
}

/* Show the text */
void showSecondScreen(void) {
  display.clearDisplay();               // Empty screen to only show the text
  display.setTextSize(2);               // Draw 2X-scale text
  display.setTextColor(SSD1306_WHITE);  // Set color to white
  display.setCursor(10, 0);             // Put the cursor a bit more in the screen (x=10)
  display.println(F("Sidra"));          // Print name 1
  display.setCursor(10, 17);            // Put the cursor a bit more in the screen (x=10) and underneath the first option (y=17)
  display.println(F("&"));              // Print &
  display.setCursor(10, 34);            // Put the cursor a bit more in the screen (x=10) and underneath the first option (y=34)
  display.println(F("Philipp"));        // Print name 2
  display.display();                    // Show text on display
  delay(100);                           // Pause before scroll animation

  // Scroll in right and left, pausing in-between (from example code)
  display.startscrollright(0x00, 0x0F);
  delay(2000);
  display.stopscroll();
  delay(1000);
  display.startscrollleft(0x00, 0x0F);
  delay(2000);
  display.stopscroll();
  delay(1000);
}
